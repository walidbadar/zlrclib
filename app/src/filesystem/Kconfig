## app/src/filesystem/Kconfig
```kconfig
#
# Copyright (c) 2025 Muhammad Waleed Badar
#
# SPDX-License-Identifier: Apache-2.0
#

menu "ZLRCLIB Filesystem Configuration"

config ZLRCLIB_FS_PATH_LEN
	int "Maximum path length"
	default 128
	range 32 1024
	help
	  Defines the maximum path length used by ZLRCLIB filesystem.
	  Increase this value if you expect longer file paths are needed.

endmenu
```

## lib/Kconfig
```kconfig
#
# Copyright (c) 2025 Muhammad Waleed Badar
#
# SPDX-License-Identifier: Apache-2.0
#

menu "Network Additional libraries"

rsource "requests/Kconfig"
rsource "wifi_conn_mgr/Kconfig"

endmenu
```

## lib/requests/Kconfig
```kconfig
#
# Copyright (c) 2025 Muhammad Waleed Badar
#
# SPDX-License-Identifier: Apache-2.0
#

menuconfig REQUESTS
	bool "Enable Requests library"
	depends on NET_SOCKETS 
	depends on HTTP_CLIENT
	depends on JSON_LIBRARY
	depends on DNS_RESOLVER
	help
	  Enable the requests library for performing HTTP(S) requests.

if REQUESTS

menu "Requests Configuration"

config REQUESTS_HTTP_PORT
	int "Default HTTP port"
	default 80
	help
	  The default port used for HTTP requests.

config REQUESTS_HTTPS_PORT
	int "Default HTTPS port"
	default 443
	help
	  The default port used for HTTPS requests.

endmenu

module = REQUESTS
module-str = requests
source "subsys/logging/Kconfig.template.log_config"

endif # REQUESTS
```

## lib/wifi_conn_mgr/Kconfig
```kconfig
#
# Copyright (c) 2025 Muhammad Waleed Badar
#
# SPDX-License-Identifier: Apache-2.0
#

menuconfig WIFI_CONNECTION_MANAGER
    bool "Enable WiFi Connection Manager"
    depends on WIFI
    depends on NET_L2_WIFI_MGMT
    select LED
    help
      Enable the WiFi connection manager subsystem, which handles WiFi
      connection and disconnection logic, retry policies, and optional
      access-point and DHCP server support.

if WIFI_CONNECTION_MANAGER

menu "WiFi Station Configuration"

config WIFI_STATIC_SSID
    string "WiFi SSID"
    default "YourSSID"
    help
      The SSID of the WiFi network to connect to in station (client) mode.

config WIFI_STATIC_PSK
    string "WiFi Password"
    default "YourPassword"
    help
      The pre-shared key (password) for the WiFi network.

config WIFI_CONN_RETRY_DELAY
    int "WiFi Connection Retry Delay (seconds)"
    default 5
    help
      Time in seconds to wait before retrying a failed connection attempt.

endmenu  # WiFi Station Configuration

menu "WiFi Access Point Configuration"

config WIFI_AP_STATIC_SSID
    string "Access Point SSID"
    default "Zephyr-AP"
    help
      SSID that will be broadcast when running in AP mode.

config WIFI_AP_STATIC_PSK
    string "Access Point Password"
    default ""
    help
      WPA2 password for the access point. Leave empty for open network.

config WIFI_AP_STATIC_IP_ADDR
    string "Static IP Address"
    default "192.168.4.1"
    help
      IP address assigned to the device in AP mode.

config WIFI_AP_STATIC_NETMASK
    string "Static Netmask"
    default "255.255.255.0"
    help
      Network mask used in AP mode.

endmenu  # WiFi Access Point Configuration

menu "DHCP Server Configuration"

config NET_DHCPV4_SERVER
    bool "Enable DHCP Server"
    default y if WIFI_USAGE_MODE_STA_AP
    help
      Enable a DHCP server when in AP mode. Devices connecting to the
      AP will be assigned IP addresses automatically.

endmenu  # DHCP Server Configuration

module = WIFI_CONNECTION_MANAGER
module-str = wifi_conn_mgr
source "subsys/logging/Kconfig.template.log_config"

endif  # WIFI_CONNECTION_MANAGER
```

## subsys/net/lib/Kconfig
```kconfig
# Copyright (c) 2025 Muhammad Waleed Badar
# SPDX-License-Identifier: Apache-2.0

rsource "wifi_conn_mgr/Kconfig"
```

## subsys/net/lib/requests/Kconfig
```kconfig
# Copyright (c) 2025 Muhammad Waleed Badar
# SPDX-License-Identifier: Apache-2.0

menuconfig REQUESTS
	bool "Enable Requests library"
	depends on NET_SOCKETS 
	depends on HTTP_CLIENT
	depends on JSON_LIBRARY
	depends on DNS_RESOLVER
	help
	  Enable the requests library for performing HTTP(S) requests.

if REQUESTS

menu "Requests Configuration"

config REQUESTS_HTTP_PORT
	int "Default HTTP port"
	default 80
	help
	  The default port used for HTTP requests.

config REQUESTS_HTTPS_PORT
	int "Default HTTPS port"
	default 443
	help
	  The default port used for HTTPS requests.

config REQUESTS_SSL_CERTS
	string "SSL Certificate"
	default "google.der.inc"
	help
	  The default SSL Certificate used for requests.

config REQUESTS_SHELL
	bool "Enable shell commands for Requests library"
	depends on SHELL
	select LOG
	help
	  Enable Zephyr shell commands for the Requests library.
	  This allows you to perform HTTP GET and POST requests directly
	  from the Zephyr shell, e.g.:
	    uart:~$ requests get http://google.com/

endmenu

module = REQUESTS
module-str = requests
source "subsys/logging/Kconfig.template.log_config"

endif # REQUESTS
```

## west.yml
```yaml
# Copyright (c) 2025 Muhammad Waleed Badar
# SPDX-License-Identifier: Apache-2.0

manifest:
  self:
    west-commands: scripts/west-commands.yml

  remotes:
    - name: zephyrproject-rtos
      url-base: https://github.com/zephyrproject-rtos

  projects:
    - name: zephyr
      remote: zephyrproject-rtos
      revision: v4.3.0
      import:
        # By using name-allowlist we can clone only the modules that are
        # strictly needed by the application.
        name-allowlist:
          - picolibc
          - mcuboot
          - mbedtls
          - lvgl
          - littlefs
          - fatfs
          - hal_espressif

    - name: requests
      url: https://github.com/walidbadar/requests.git
      revision: main
      path: modules/lib/requests
```
